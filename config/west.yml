## config/west.yml
```yaml
manifest:
  remotes:
    - name: zmkfirmware
      url-base: https://github.com/zmkfirmware
    - name: kikangh
      url-base: https://github.com/Kikangh
  projects:
    - name: zmk
      remote: Kikangh
      revision: 2024MouseBehavior
      import: app/west.yml
  self:
    path: config
```
